## buildroot/package/emulators/Config.in
```kconfig
# Batocera Emulators

source "package/emulators/advancemame/Config.in"
source "package/emulators/amiberry/Config.in"
source "package/emulators/cannonball/Config.in"
source "package/emulators/cemu/Config.in"
source "package/emulators/cgenius/Config.in"
source "package/emulators/citra/Config.in"
source "package/emulators/daphne/Config.in"
source "package/emulators/devilutionx/Config.in"
source "package/emulators/dolphin-emu/Config.in"
source "package/emulators/dosbox/Config.in"
source "package/emulators/dosbox-staging/Config.in"
source "package/emulators/dosbox-x/Config.in"
source "package/emulators/drastic/Config.in"
source "package/emulators/duckstation/Config.in"
source "package/emulators/easyrpg/Config.in"
source "package/emulators/flycast/Config.in"
source "package/emulators/fpinball/Config.in"
source "package/emulators/fsuae/Config.in"
source "package/emulators/gsplus/Config.in"
source "package/emulators/hatari/Config.in"
source "package/emulators/lightspark/Config.in"
source "package/emulators/linapple/Config.in"
source "package/emulators/mame/Config.in"
source "package/emulators/melonds/Config.in"
source "package/emulators/moonlight-embedded/Config.in"
source "package/emulators/mupen64plus/Config.in"
source "package/emulators/openbor/Config.in"
source "package/emulators/pcsx2/Config.in"
source "package/emulators/pcsx2_avx2/Config.in"
source "package/emulators/ppsspp/Config.in"
source "package/emulators/ppsspp15/Config.in"
source "package/emulators/python-pygame2/Config.in"
source "package/emulators/redream/Config.in"
source "package/emulators/retroarch/Config.in"
source "package/emulators/rpcs3/Config.in"
source "package/emulators/ruffle/Config.in"
source "package/emulators/scummvm/Config.in"
source "package/emulators/sdlpop/Config.in"
source "package/emulators/solarus-engine/Config.in"
source "package/emulators/sonic2013/Config.in"
source "package/emulators/soniccd/Config.in"
source "package/emulators/supermodel/Config.in"
source "package/emulators/tsugaru/Config.in"
source "package/emulators/vice/Config.in"
source "package/emulators/xemu/Config.in"
source "package/emulators/yuzu/Config.in"
```

## buildroot/package/emulators/easyrpg/Config.in
```kconfig
source "package/emulators/easyrpg/easyrpg-player/Config.in"
source "package/emulators/easyrpg/liblcf/Config.in"
```
